## Kconfig
```kconfig
mainmenu "FPVM Configuration"

choice
    prompt "Target Architecture"
    default ARCH_X64

    config ARCH_X64
        bool "x64"
	help
            Intel 64 bit with at least SSE

    config ARCH_ARM64
        bool "arm64"
	help
            ARM 64 bit architecture.  The machine must support traps, which are optional on ARM

    config ARCH_RISCV64
        bool "RISC-V (64)"
	help
	    RISC-V 64 bit architecture with at least F and D
	    This will only work on a "RAFT-V"


endchoice


config RISCV_HAVE_FP_TRAPS
   bool "RISC-V Supports Floating Point Traps (RAFT-V)"
   default n
   depends on ARCH_RISCV64
   help
       Hardware support for floating point traps
       Not available in standard RISC-V, only RAFT-V

config RISCV_TRAP_PIPELINED_EXCEPTIONS
   bool "Do Trap Delivery Via PPEs (RAFT-V)"
   depends on RISCV_HAVE_FP_TRAPS
   default n
   help
       Use hardware support for Precise Pipeline Exceptions (PPEs)
       to deliver floating point traps
       Not available in standard RISC-V, only RAFT-V
       The kernel module also needs to be inserted

config RISCV_USE_ESTEP
   bool "Do Breakpoint Delivery vie PPEs (RAFT-V)"
   depends on RISCV_HAVE_FP_TRAPS
   default n
   help
       Use hardware support for Precise Pipeline Exections (PPEs)
       to deliver breakpoint exceptions via the ESTEP instruction.
       Not available on standard RISC-V, only RAFT-V
       The kernel module also needs to be inserted

config NO_OUTPUT
    bool "Disable output"
    default n

config DEBUG
    bool "Debug output"
    default n

config DEBUG_ALT_ARITH
    bool "Debug alternative arithmetic"
    default n

config TELEMETRY
    bool "Basic telemetry"
    default n
    help
       This will print out basic info that is always recorded

config TELEMETRY_PROMOTIONS
    bool "Track promotions and demotions"
    depends on TELEMETRY
    default n
    help
       This will include demotion/promotion and
       correctness demotions, which currently are more
       expensive to track than they should be

config TELEMETRY_PERIOD
    depends on TELEMETRY
    int "Reporting period"
    default 0
    help
        Number of FP traps between telemetry reports
	0 means that reports are generated only at thread end / process end

config PERF_STATS
    bool "Performance measurement"
    default n

config PERF_STATS_PERIOD
    depends on PERF_STATS
    int "Reporting period"
    default 0
    help
        Number of FP traps between performance statistics reports
	0 means that reports are generated only at thread end / process end

config ENABLE_PULSE_PROFILING
    bool "Enable the pulse profiler (throw fpvm.json into https://ui.perfetto.dev/)"
    depends on PERF_STATS
    default n


config TRAP_SHORT_CIRCUITING
    bool "Trap short-circuiting (hardware support)"
    depends on  RISCV_TRAP_PIPELINED_EXCEPTIONS && RISCV_USE_ESTEP
    default n
    help
       Use user-level trap handling if possible

config KERNEL_SHORT_CIRCUITING
    bool "Kernel short-circuiting (kernel support)"
    depends on ARCH_X64
    default y
    help
       Use the FPVM kernel support to do much faster trap delivery

config INSTR_SEQ_EMULATION
    bool "Instruction sequence emulation"
    default y
    help
       Emulate as many instructions as possible per trap

config MAGIC_CORRECTNESS_TRAP
    bool "Correctness traps via calls (Magic trap)"
    default y
    help
       Add support to deliver correctness traps via
       calls.  The static binary analysis must also
       be configured to use this feature



# Add your own alternative math here
choice
    prompt "Alternative number system"
    default ALT_MATH_VANILLA

    config ALT_MATH_VANILLA
        bool "Vanilla"
	help
            Simply emulate using a normal instruction
            Vanilla is always included as a fallback


    config ALT_MATH_BOXED_IEEE
        bool "Boxed IEEE"

    config ALT_MATH_POSIT
        bool "POSIT"

    config ALT_MATH_MPFR
        bool "GNU MPFR"


    config MPFR_PRECISION
        int "MPFR Precision"
		    default 200
		    depends on ALT_MATH_MPFR

    config ALT_MATH_EXPR_TRACE
        bool "Expression-based thunk tracing"

    config ALT_MATH_RATIONAL
        bool "Rationals"


    config ALT_MATH_TEENY
        bool "Teeny Floats"
        help
            These are small floats that can be directly encoded into a nan

config TEENY_EXP_BITS
    int "Teeny exponent size (bits)"
		default 8 
		depends on ALT_MATH_TEENY
    help
       The exponent size must be <12

config TEENY_MANT_BITS
    int "Teeny mantissa size (bit)"
		default 16 
		depends on ALT_MATH_TEENY
    help
       The exponent size + mantissa size + 1 must be <= 50

endchoice

menu "Parameters"
   config MAX_CONTEXTS
      int "Maximum Simultaneous Contexts"
      default 1024
      help
          Maximum number of simultaneous contexts (threads, basically)
	  that can be simultaneously traced.
   config DECODE_CACHE_SIZE
      int "Decode Cache Size (ideally prime number)"
      default 65537
      help
          The number of entries in the instruction decode cache
endmenu

menu "Experimental Features"
config FPTRAPALL
    bool "Trap all floating point operations (Set CR0.TS)"
    depends on ARCH_X64
    default n
    help
      Use the fptrapall kernel module to trap all floating point operations
      by setting the CR0.TS bit.
endmenu

menu "Developer Features"
config TOOLCHAIN_PREFIX
   string "Toolchain Prefix"
   default ""
   help
      Prefix for all compilation tools (for cross-compilation use)
      "riscv64-unknown-linux-gnu-" is used for cross-compiling
      for riscv64, which is necessary for the RAFT-V setup

config CAPSTONE_DIR
   string "Capstone Install Directory"
   default ""
   help
      Install directory for Capstone, which must include
      support for your architecture

config HAVE_MAIN
    bool "Build FPVM as a simple executable with a main()"
    default n
    help
       This compiles it with a main function
       that can be used for testing without LD_PRELOAD

config RUN_ALT_CALC
    bool "Run Alternative Arithmetic Calculator"
    default n
    help
       Runs the calculator either early in main (if HAVE_MAIN)
       or on shared library startup

config USE_NVM
    bool "Use NVM"
    depends on ARCH_X64
    default n
    help
       Use the NVM virtual machine for ordinary processing
       This is for hacking around on NVM

config ENABLE_NVM_LOGGING
    bool "Enable NVM Logging"
    depends on USE_NVM
    default n

config INSTR_TRACES
    bool "Instruction tracing and analysis"
    default n

config INSTR_TRACES_PERIOD
    depends on INSTR_TRACES
    int "Reporting period"
    default 0
    help
        Number of FP traps between trace reports
	0 means that reports are generated only at thread end / process end


endmenu
```
